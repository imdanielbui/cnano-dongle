#define TRACKBALL_MISO NRF_PSEL(SPIM_MISO, 0, 24)
#include "charybdis_half.dtsi"
#include "charybdis_spi_pinctrl.dtsi"
#include "charybdis_3610.dtsi"

&trackball_split2 {
    device = <&trackball_left>;
};
