## config/west.yml
```yaml
manifest:
  remotes:
    - name: zmkfirmware
      url-base: https://github.com/zmkfirmware
    - name: badjeff
      url-base: https://github.com/badjeff
    - name: nrfconnect
      url-base: https://github.com/nrfconnect
    - name: sigvah
      url-base: https://github.com/sigvah
    - name: carrefinho
      url-base: https://github.com/carrefinho
    - name: caksoylar
      url-base: https://github.com/caksoylar
    # - name: sadekbaroudi
    #   url-base: https://github.com/sadekbaroudi
    # - name: dhruvinsh
    #   url-base: https://github.com/dhruvinsh
    - name: englmaxi
      url-base: https://github.com/englmaxi
  projects:
    - name: zmk
      remote: zmkfirmware
      revision: 4de313367288aad5aeaa1243890e40dc813f7008
      import: app/west.yml

    - name: zmk-pmw3610-driver
      remote: badjeff
      revision: 44b4a76b74d293a93cec4ccb7e04cb8d29c10f93

    - name: zmk-driver-pmw3360
      url: https://github.com/george-norton/zmk-driver-pmw3360
      revision: 0dfa2f0411b795613a35f222f993e45a1e4cc32a

    - name: zmk-dongle-display
      remote: englmaxi
      revision: main

    - name: forager-zmk-module
      remote: carrefinho
      revision: main
    - name: zmk-rgbled-widget
      remote: caksoylar
      revision: main
    - name: zmk-keyboards-visorbearer
      repo-path: visorbearer-zmk-module
      remote: carrefinho
      revision: main

    # - name: zmk-tri-state
    #   remote: dhruvinsh
    #   revision: main
    # - name: zmk-fingerpunch-keyboards
    #   remote: sadekbaroudi
    #   revision: main
    #   import: config/deps.yml

    - name: prospector-zmk-module
      remote: carrefinho
      revision: feat/new-status-screens

  self:
    path: config
```
